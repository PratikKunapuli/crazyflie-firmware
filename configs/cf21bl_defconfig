## configs/cf21bl_defconfig
```kconfig
CONFIG_PLATFORM_CF21BL=y

CONFIG_MOTORS_REQUIRE_ARMING=y
CONFIG_MOTORS_ESC_PROTOCOL_DSHOT=y

CONFIG_CONTROLLER_PID_FILTER_ALL=y
CONFIG_ENABLE_THRUST_BAT_COMPENSATED=n
```
